## meta-openxt-base/conf/machine/xenclient-common.conf
```bitbake
# Copyright (C) 2010 Citrix Systems
# Released under the MIT license (see packages/COPYING)

# Tune for Core 2 CPU
require conf/machine/include/x86/tune-core2.inc

DEFAULTTUNE = "core2-64"

TUNE_CCARGS:remove = "-mstackrealign"

KERNEL_IMAGETYPE = "bzImage"

# Wrynose: MACHINE_FEATURES_BACKFILL_CONSIDERED → MACHINE_FEATURES_OPTED_OUT
MACHINE_FEATURES_OPTED_OUT += "rtc"
```
