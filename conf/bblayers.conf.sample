## conf/bblayers.conf.sample
```bitbake
# Sample fragment — merge into your build/conf/bblayers.conf
# Adjust OPENXT_OE to this repository's absolute path.

# OPENXT_OE = "/path/to/xenclient-oe"

# --- Headless / base only ---
# ${OPENXT_OE}/meta-openxt-base

# --- Service domains ---
# ${OPENXT_OE}/meta-openxt-domains

# --- Full UI product ---
# ${OPENXT_OE}/meta-openxt-ui

LCONF_VERSION = "7"

BBPATH = "${TOPDIR}"
BBFILES ?= ""

# Example full product (paths are placeholders):
# BBLAYERS ?= " \
#   /path/to/openembedded-core/meta \
#   /path/to/meta-openembedded/meta-oe \
#   /path/to/meta-openembedded/meta-python \
#   /path/to/meta-openembedded/meta-networking \
#   /path/to/meta-selinux \
#   /path/to/meta-virtualization \
#   /path/to/meta-intel \
#   /path/to/meta-openxt-haskell-platform \
#   /path/to/meta-openxt-ocaml-platform \
#   /path/to/meta-gnome \
#   /path/to/meta-xfce \
#   /path/to/vglass \
#   /path/to/meta-java \
#   /path/to/xenclient-oe/meta-openxt-base \
#   /path/to/xenclient-oe/meta-openxt-domains \
#   /path/to/xenclient-oe/meta-openxt-ui \
# "
```

## meta-openxt-base/conf/layer.conf
```bitbake
# meta-openxt-base — platform core (initially hosts full tree; domains/UI extracted next)
BBPATH .= ":${LAYERDIR}"

BBMASK += " \
    meta-virtualization/recipes-extended/images/xen-guest-image-minimal.bb \
    meta-virtualization/recipes-devtools/go/go-build_git.bb \
    meta-virtualization/recipes-core/runx/runx_git.bb \
"

BBFILES += " \
    ${LAYERDIR}/recipes-*/*/*.bb \
    ${LAYERDIR}/recipes-*/*/*.bbappend \
    ${LAYERDIR}/recipes-*/*/*/*.bb \
    ${LAYERDIR}/recipes-*/*/*/*.bbappend \
"

BBFILE_COLLECTIONS += "openxt-base"
BBFILE_PATTERN_openxt-base := "^${LAYERDIR}/"
BBFILE_PRIORITY_openxt-base = "9"

LAYERVERSION_openxt-base = "1"
LAYERSERIES_COMPAT_openxt-base = "dunfell"

# Full deps retained until domains/UI extraction; narrowed in follow-up commits.
LAYERDEPENDS_openxt-base = " \
    core \
    openembedded-layer \
    meta-python \
    virtualization-layer \
    selinux \
    intel \
    meta-openxt-haskell-platform \
    meta-openxt-ocaml-platform \
    gnome-layer \
    xfce-layer \
    vglass \
    meta-java \
"

LAYERDESCRIPTION_openxt-base = "OpenXT base layer: dom0, toolstack, security, installer, stubdomain"

LICENSE_PATH += " ${LAYERDIR}/files/additional-licenses/"
```

## meta-openxt-domains/conf/distro/include/openxt-domains.inc
```bitbake
# Service-domain distro preferences (loaded when meta-openxt-domains is present).
PREFERRED_VERSION_networkmanager ?= "1.18.4"
```

## meta-openxt-domains/conf/layer.conf
```bitbake
# meta-openxt-domains — NDVM, USBVM, SyncVM service domains
BBPATH .= ":${LAYERDIR}"

BBFILES += " \
    ${LAYERDIR}/recipes-*/*/*.bb \
    ${LAYERDIR}/recipes-*/*/*.bbappend \
    ${LAYERDIR}/recipes-*/*/*/*.bb \
    ${LAYERDIR}/recipes-*/*/*/*.bbappend \
"

BBFILE_COLLECTIONS += "openxt-domains"
BBFILE_PATTERN_openxt-domains := "^${LAYERDIR}/"
BBFILE_PRIORITY_openxt-domains = "10"

LAYERVERSION_openxt-domains = "1"
LAYERSERIES_COMPAT_openxt-domains = "dunfell"

LAYERDEPENDS_openxt-domains = " \
    openxt-base \
    networking-layer \
"

LAYERDESCRIPTION_openxt-domains = "OpenXT service domain images: NDVM, USBVM, SyncVM"

require ${LAYERDIR}/conf/distro/include/openxt-domains.inc
```

## meta-openxt-domains/conf/machine/xenclient-syncvm.conf
```bitbake
require conf/machine/xenclient-common.conf

MACHINE_FEATURES = "pci acpi ext2 x86"
```

## meta-openxt-ui/conf/distro/include/openxt-ui.inc
```bitbake
# Included when meta-openxt-ui is part of the product build.

DISTRO_FEATURES_append += " opengl openxt-ui"

PREFERRED_VERSION_dojosdk-native ?= "1.7.12"
PREFERRED_VERSION_dojosdk-native_xenclient-syncui ?= "1.8.1"

PREFERRED_VERSION_network-manager-applet ?= "1.8.22"

PREFERRED_PROVIDER_virtual/java-initial = "cacao-initial"
PREFERRED_PROVIDER_virtual/java-initial-native = "cacao-initial-native"
PREFERRED_PROVIDER_virtual/java-native = "jamvm-native"
PREFERRED_PROVIDER_virtual/javac-native = "ecj-bootstrap-native"
```

## meta-openxt-ui/conf/layer.conf
```bitbake
# meta-openxt-ui — UIVM and dom0 display/input integration
BBPATH .= ":${LAYERDIR}"

BBFILES += " \
    ${LAYERDIR}/recipes-*/*/*.bb \
    ${LAYERDIR}/recipes-*/*/*.bbappend \
    ${LAYERDIR}/recipes-*/*/*/*.bb \
    ${LAYERDIR}/recipes-*/*/*/*.bbappend \
"

BBFILE_COLLECTIONS += "openxt-ui"
BBFILE_PATTERN_openxt-ui := "^${LAYERDIR}/"
BBFILE_PRIORITY_openxt-ui = "11"

LAYERVERSION_openxt-ui = "1"
LAYERSERIES_COMPAT_openxt-ui = "dunfell"

LAYERDEPENDS_openxt-ui = " \
    openxt-base \
    openxt-domains \
    gnome-layer \
    xfce-layer \
    vglass \
    meta-java \
"

LAYERDESCRIPTION_openxt-ui = "OpenXT UI layer: UIVM, glass/display, dom0 UI integration"

require ${LAYERDIR}/conf/distro/include/openxt-ui.inc
```
